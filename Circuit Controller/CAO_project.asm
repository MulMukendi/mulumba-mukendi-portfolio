;please note our buttons in proteus need to be pressed for some seconds for all the needed LED's to switch on.

;Declaration
STATUS EQU 03H
PORTA EQU 05H
PORTB EQU 06H
TRISA EQU 85H
TRISB EQU 86H

RA0 EQU 0 ;BTN1
RA1 EQU 1 ;BTN2
RA2 EQU 2 ;BTN3
RA3 EQU 3 ;BTN4

RP0 EQU 5 ;5TH BIT OF STATUS REGISTER

RB0 EQU 0 ;THE LED'S
RB1 EQU 1
RB2 EQU 2
RB3 EQU 3
RB4 EQU 4
RB5 EQU 5

;Config Mode
ORG 00H
BSF STATUS, RP0 ;MOVE FROM BANK 0 TO BANK 1

;SET BUTTONS AS INPUT
BSF TRISA, RA0
BSF TRISA, RA1
BSF TRISA, RA2
BSF TRISA, RA3

;SET LED PINS AS OUTPUT
BCF TRISB, RB0 
BCF TRISB, RB1 
BCF TRISB, RB2 
BCF TRISB, RB3 
BCF TRISB, RB4 
BCF TRISB, RB5

BCF STATUS, RP0 ;GO BACK TO BANK 0

;RUNNING MODE
START
    CLRF PORTB
    BTFSC PORTA, 0
    GOTO BTN1PRESSED
    BTFSC PORTA, 1
    GOTO BTN2PRESSED
    BTFSC PORTA, 2
    GOTO BTN3PRESSED
    BTFSC PORTA, 3
    GOTO BTN4PRESSED
    GOTO START

BTN1PRESSED
    BCF PORTB, 1
    BCF PORTB, 2
    BCF PORTB, 3
    BCF PORTB, 4
    BCF PORTB, 5
    GOTO START

BTN2PRESSED
    BSF PORTB, 0
    BCF PORTB, 1
    BSF PORTB, 2
    BCF PORTB, 3
    BSF PORTB, 4
    BCF PORTB, 5
    GOTO START

BTN3PRESSED
    BCF PORTB, 0
    BSF PORTB, 1
    BCF PORTB, 2
    BSF PORTB, 3
    BCF PORTB, 4
    BSF PORTB, 5
    GOTO START

BTN4PRESSED
    BSF PORTB, 0
    BSF PORTB, 1
    BSF PORTB, 2
    BSF PORTB, 3
    BSF PORTB, 4
    BSF PORTB, 5
	GOTO START

END